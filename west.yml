## west.yml
```yaml
manifest:
  remotes:
    - name: remote1
      url-base: https://github.com/zephyrproject-rtos

  projects:
    - name: zephyr
      remote: remote1
      revision: main
      import: 
        - name-allowlist:
            - cmsis
            - hal_stm32
            - hal_nxp
            - littlefs
            - tinycrypt
            - mbedtls
            - mcuboot
            - hal_rpi_pico
    

  self:
    path: mini_zephyr
```
